## config/west.yml
```yaml
manifest:
  remotes:
    - name: zmkfirmware
      url-base: https://github.com/zmkfirmware
    - name: urob
      url-base: https://github.com/urob
    - name: dhruvinsh
      url-base: https://github.com/dhruvinsh
  projects:
    - name: zmk
      remote: zmkfirmware
      revision: v0.3
      import: app/west.yml

    - name: zmk-helpers
      remote: urob
      revision: v0.3

    - name: zmk-tri-state
      remote: dhruvinsh
      revision: v0.3
  self:
    path: config
```
