/ {
    kscan: kscan {
        compatible = "zmk,kscan-gpio-matrix";
        diode-direction = "col2row";
        wakeup-source;

        col-gpios
            = <&pro_micro 21 GPIO_ACTIVE_HIGH> // A3
            , <&pro_micro 20 GPIO_ACTIVE_HIGH> // A2
            , <&pro_micro 19 GPIO_ACTIVE_HIGH> // A1
            , <&pro_micro 18 GPIO_ACTIVE_HIGH> // A0
            , <&pro_micro 15 GPIO_ACTIVE_HIGH> // 15
            , <&pro_micro 14 GPIO_ACTIVE_HIGH> // 14
            ;

        row-gpios
            = <&pro_micro 4 (GPIO_ACTIVE_HIGH | GPIO_PULL_DOWN)> // 4 (Top row)
            , <&pro_micro 5 (GPIO_ACTIVE_HIGH | GPIO_PULL_DOWN)> // 5 (Middle row)
            , <&pro_micro 6 (GPIO_ACTIVE_HIGH | GPIO_PULL_DOWN)> // 6 (Bottom row)
            , <&pro_micro 7 (GPIO_ACTIVE_HIGH | GPIO_PULL_DOWN)> // 7 (Thumb cluster)
            ;
    };
};
